#include <SPI.h>
#include <string.h>
#include <LittleFS.h>
#include "background.h"
#include "font.h"
#include "cn_font.h"
#include "menu.h"
#include "nrf24.h"

// user layout generated by the GP-Fusion PC app (optional, overrides presets)
#if __has_include("layout_user.h")
#include "layout_user.h"
#else
#define USER_LEVER_X 38
#define USER_LEVER_Y 80
#define USER_LEVER_RING 22
#define USER_LEVER_KNOB 7
#endif

// default button layout, generated by the GP-Fusion PC app (0=街机 1=HITBOX 2=WASD 3=自定义)
#if __has_include("defaults.h")
#include "defaults.h"
#endif
#ifndef DEFAULT_LAYOUT
#define DEFAULT_LAYOUT 1
#endif

#define CS 10
#define DC 9
#define RST 8
#define BL 13
#define ESP_RX 44 // GPIO44, silkscreen "RX" <- Pico TX (GPIO0)
#define ESP_TX 43 // GPIO43, silkscreen "TX" -> Pico RX (GPIO1)

#define UART_BAUD 921600

#define FRAME_MAGIC       0xAA
#define FRAME_VERSION     1
#define FRAME_TYPE_INPUT  0x01
#define FRAME_TYPE_ACK    0x02
#define FRAME_TYPE_STATUS 0x03
#define FRAME_TYPE_CONFIG 0x04
#define FRAME_TYPE_CONFIG_ACK 0x05
#define FRAME_TYPE_LED   0x06

// ---- views ----
#define VIEW_LAYOUT 0   // default: button layout + status
#define VIEW_MENU   1   // sliding square menu (enter: hold S2 3s)
#define VIEW_SUB    2   // sub-page of the selected menu item

// ---- menu layout: LANDSCAPE content 240x135 ----
// Driver init, OX/OY offsets and the 135x240 window stay untouched;
// the landscape frame is rotated in software when pushed to the panel.
#define NUM_PAGES      6
#define ICON_W         86
#define ICON_X         ((240 - ICON_W) / 2)
#define ICON_Y         26
#define TITLE_Y        6
#define THUMB_Y        122
#define THUMB_SIZE     8
#define THUMB_GAP      6
#define ANIM_MS        280
#define FRAME_MS       16      // ~60 fps pacing
#define LIST_ANIM_MS   140

#define RGB565(r,g,b)  ((((uint16_t)(r)>>3)<<11)|(((uint16_t)(g)>>2)<<5)|((uint16_t)(b)>>3))
#define COL_BG         RGB565(21,27,39)
#define COL_THUMB_ON   RGB565(64,160,255)
#define COL_THUMB_OFF  RGB565(64,72,86)
#define COL_TEXT       RGB565(215,222,235)
#define COL_RING       RGB565(150,160,175)
#define COL_HI         0xFFFF
#define COL_TEXT_ON    0x0000
#define FONT_SCALE     2
#define ACC_SETTINGS   RGB565(80,200,255)
#define ACC_BATTERY    RGB565(80,220,120)
#define ACC_LIGHT      RGB565(255,200,60)
#define ACC_MOUNTAIN   RGB565(140,120,255)
#define ACC_MOON       RGB565(220,230,255)

// landscape content framebuffer + driver-order output buffer
uint16_t lfb[240 * 135];
uint8_t  rbuf[135 * 240 * 2];

// runtime rotation mapping (base orientation is upright)
//   my = cx              (content horizontal -> memory rows)
//   mx = 134 - cy        (content vertical, reversed -> memory columns)
int rotSwapRow = 1;
int rotRevCol = 1;
bool invertScreen = false;

void cmd(uint8_t c){digitalWrite(DC,LOW);digitalWrite(CS,LOW);SPI.transfer(c);digitalWrite(CS,HIGH);}
void dat(uint8_t d){digitalWrite(DC,HIGH);digitalWrite(CS,LOW);SPI.transfer(d);digitalWrite(CS,HIGH);}
void dat16(uint16_t c){dat(c>>8);dat(c&0xFF);}
int OX=52,OY=40;
void fill(uint16_t c){cmd(0x2A);dat16(OX);dat16(OX+134);cmd(0x2B);dat16(OY);dat16(OY+239);cmd(0x2C);for(int i=0;i<135*240;i++)dat16(c);}

void setWin(uint8_t x0, uint8_t y0, uint8_t x1, uint8_t y1) {
  cmd(0x2A); dat16(x0+OX); dat16(x1+OX);
  cmd(0x2B); dat16(y0+OY); dat16(y1+OY);
  cmd(0x2C);
}

// ---- state ----
int view = VIEW_LAYOUT;
int page = 0;
int subPage = 0;
bool animating = false;
int animDir = 0;          // +1 = next (slide left), -1 = prev (slide right)
int pendingDir = 0;       // direction queued while an animation is running
unsigned long animStart = 0;
unsigned long lastFrameTime = 0;
uint16_t lastButtons = 0;
uint8_t lastDpad = 0;
unsigned long lastActivity = 0;
bool redrawNeeded = true;

// menu page metadata: titles and icon index into ICONS[]
static const char* const PAGE_TITLES[NUM_PAGES] = {"设置", "电池", "灯光", "背景", "休眠", "无线"};

static const char *const SAVER_NAMES[] = {"关闭", "雪花", "弹跳", "管道", "吐司"};
static MenuOpt sleepOpts[] = {
  {"屏保模式", OPT_ENUM, 1, 0, 4, 1, SAVER_NAMES, 5, ""},
  {"屏保时间", OPT_INT, 60, 0, 600, 10, NULL, 0, "秒"},
  {"关屏", OPT_BOOL, 1, 0, 1, 1, NULL, 0, ""},
};

// ---- settings page (设置): sections = 手柄 / 系统 ----
static const char *const INPUT_NAMES[] = {"XIN","SW","PS3","KBD","PS4","XB1","MDM","NEO",
                                          "PCE","EGR","AST","PSC","XBO","PS5","GEN","SWP","P5G"};
static const char *const SOCD_NAMES[] = {"UP","NEU","2ND","1ST","BYP"};
static const char *const DPAD_NAMES[] = {"DIG","LAN","RAN"};

static MenuOpt gpOpts[] = {
  {"输入模式", OPT_ENUM, 0, 0, 16, 1, INPUT_NAMES, 17, ""},
  {"SOCD模式", OPT_ENUM, 0, 0, 4, 1, SOCD_NAMES, 5, ""},
  {"D-Pad模式", OPT_ENUM, 0, 0, 2, 1, DPAD_NAMES, 3, ""},
  {"四向模式", OPT_BOOL, 0, 0, 1, 1, NULL, 0, ""},
  {"反向X", OPT_BOOL, 0, 0, 1, 1, NULL, 0, ""},
  {"反向Y", OPT_BOOL, 0, 0, 1, 1, NULL, 0, ""},
  {"去抖延迟", OPT_INT, 5, 1, 20, 1, NULL, 0, "ms"},
};

static MenuOpt sysOpts[] = {
  {"配置档", OPT_INT, 1, 1, 5, 1, NULL, 0, ""},
  {"保存设置", OPT_ACTION, 0, 0, 0, 0, NULL, 0, ""},
  {"恢复默认", OPT_ACTION, 0, 0, 0, 0, NULL, 0, ""},
};

static const char *const LAYOUT_NAMES[] = {"街机", "HITBOX", "WASD", "自定义"};
static MenuOpt histOpts[] = {
  {"输入历史", OPT_BOOL, 0, 0, 1, 1, NULL, 0, ""},
  {"按键布局", OPT_ENUM, DEFAULT_LAYOUT, 0, 3, 1, LAYOUT_NAMES, 4, ""},
};

static MenuSection settingsSections[] = {
  {"手柄", gpOpts, 7},
  {"显示", histOpts, 2},
  {"系统", sysOpts, 3},
};
static MenuSection sleepSections[] = {
  {"休眠", sleepOpts, 3},
};

// ---- LED page (灯光) ----
static const char *const ANIM_NAMES[] = {"静态", "彩虹", "追逐", "主题", "自定义", "流水"};
static const char *const COLOR_NAMES[] = {"BLK","WHT","RED","ORG","YEL","LME","GRN","SEA",
                                          "AQU","SKY","BLU","PUR","PNK","MAG","IND","VIO"};
static MenuOpt ledOpts[] = {
  {"动画模式", OPT_ENUM, 0, 0, 5, 1, ANIM_NAMES, 6, ""},
  {"亮度", OPT_INT, 5, 0, 5, 1, NULL, 0, ""},
  {"静态颜色", OPT_ENUM, 0, 0, 15, 1, COLOR_NAMES, 16, ""},
  {"追逐速度", OPT_SLIDER, 92, 0, 100, 1, NULL, 0, ""},
  {"彩虹速度", OPT_SLIDER, 96, 0, 100, 1, NULL, 0, ""},
  {"流水速度", OPT_SLIDER, 96, 0, 100, 1, NULL, 0, ""},
  {"挂起关灯", OPT_BOOL, 0, 0, 1, 1, NULL, 0, ""},
};
static MenuSection ledSections[] = {
  {"彩灯", ledOpts, 7},
};

// ---- background page (背景) ----
static const char *const BG_LEVEL_NAMES[] = {"25%", "40%", "55%", "70%", "85%"};
static MenuOpt bgOpts[] = {
  {"背景透明度", OPT_ENUM, 1, 0, 4, 1, BG_LEVEL_NAMES, 5, ""},
  {"背光亮度", OPT_SLIDER, 100, 0, 100, 1, NULL, 0, ""},
  {"水平翻转", OPT_BOOL, 0, 0, 1, 1, NULL, 0, ""},
  {"垂直翻转", OPT_BOOL, 0, 0, 1, 1, NULL, 0, ""},
  {"反色", OPT_BOOL, 0, 0, 1, 1, NULL, 0, ""},
};
static MenuSection bgSections[] = {
  {"背景", bgOpts, 5},
};

// ---- wireless page (无线) ----
static const char *const WL_PWR_NAMES[] = {"低", "中", "高", "最高"};
static const char *const WL_RATE_NAMES[] = {"2M高速", "1M远距"};
static const char *const WL_HB_NAMES[] = {"省电", "标准", "高速"};
static MenuOpt wlOpts[] = {
  {"无线开关", OPT_BOOL, 1, 0, 1, 1, NULL, 0, ""},
  {"信道", OPT_INT, 120, 0, 125, 1, NULL, 0, ""},
  {"发射功率", OPT_ENUM, 3, 0, 3, 1, WL_PWR_NAMES, 4, ""},
  {"数据速率", OPT_ENUM, 0, 0, 1, 1, WL_RATE_NAMES, 2, ""},
  {"心跳频率", OPT_ENUM, 1, 0, 2, 1, WL_HB_NAMES, 3, ""},
  {"重新配对", OPT_ACTION, 0, 0, 0, 0, NULL, 0, ""},
};
static MenuSection wlSections[] = {
  {"无线", wlOpts, 6},
};

static SubPageDef subDefs[NUM_PAGES] = {
  {settingsSections, 3},  // 设置
  {NULL, 0},              // 电池 - status page later
  {ledSections, 1},       // 灯光
  {bgSections, 1},        // 背景
  {sleepSections, 1},     // 休眠
  {wlSections, 1},        // 无线
};
int subSel = 0;
int subSection = 0;
bool subList = false;
int subScroll = 0;   // first visible option row
int secScroll = 0;   // first visible section row
unsigned long lastStepTime = 0;
float selY = 0, selYFrom = 0, selYTo = 0;        // animated selection position
float scrollOff = 0, scrollFrom = 0, scrollTo = 0; // animated scroll offset
unsigned long listAnimStart = 0;
bool listAnimating = false;
bool subDirty = false;          // option values changed since last save/entry
bool confirmOpen = false;       // save-confirm dialog open
int confirmChoice = 0;          // 0 = 是, 1 = 否
bool sliderMode = false;        // A entered a slider row: left/right adjusts
int sliderIdx = 0;
static int16_t optSnap[MAX_SUB_OPTS];
unsigned long lastConfigSent = 0;   // suppress stale STATUS sync right after push
unsigned long savedFlashUntil = 0;   // "已保存" toast
bool configAcked = false;            // Pico confirmed the config apply
float layoutScale = 1.0f;            // 0.78 when input history strip is shown

// ---- input history (recent button presses on the layout view) ----
#define HIST_MAX 14
static char histLabels[HIST_MAX][3];
static int histCount = 0;   // entries currently stored
static int histHead = 0;    // ring index of the newest slot

// status received from the Pico (STATUS frames)
uint8_t stSocd = 0;
uint8_t stDpadMode = 0;
uint8_t stInputMode = 0;
uint8_t stFlags = 0;
uint16_t stBattMv = 0;
uint8_t stBattFlags = 0;

// ---- wireless (nRF24L01 on the ESP32) ----
NRF24 radio;
SPIClass nrfSpi(HSPI);
#define NRF_CSN 14
#define NRF_CE  15
bool radioUp = false;
uint8_t radioSeq = 0;
unsigned long lastRadioSend = 0;
int radioHeartbeatMs = 20;
static uint8_t radioPrevState[13];
// link quality: ACK results over the last 100 packets
uint8_t radioHist[100];
uint8_t radioHistIdx = 0;
uint8_t radioHistOk = 0;
bool radioLinked = false;
// full gamepad state received from the Pico over UART
uint16_t lastLX = 0x8000, lastLY = 0x8000, lastRX = 0x8000, lastRY = 0x8000;
uint8_t lastLT = 0, lastRT = 0;


// S2 hold-to-enter-menu
bool s2WasHeld = false;
unsigned long s2PressStart = 0;

// ---- framebuffer helpers ----
inline void lfbSet(int x, int y, uint16_t c) {
  if (x >= 0 && x < 240 && y >= 0 && y < 135) lfb[y * 240 + x] = c;
}

// ---- Chinese font (16x16 1bpp, generated by cn_font_gen.py) ----
int cnFind(uint16_t cp) {
  int lo = 0, hi = CN_FONT_NUM - 1;
  while (lo <= hi) {
    int mid = (lo + hi) >> 1;
    if (CN_FONT_CODES[mid] == cp) return mid;
    if (CN_FONT_CODES[mid] < cp) lo = mid + 1; else hi = mid - 1;
  }
  return -1;
}

void drawCJKChar(int x, int y, uint16_t cp, uint16_t color, int scale) {
  int idx = cnFind(cp);
  if (idx < 0 || scale < 1) return;
  const uint8_t *g = CN_FONT_GLYPHS[idx];
  for (int row = 0; row < 16; row++) {
    for (int col = 0; col < 16; col++) {
      if ((g[row * 2 + col / 8] >> (7 - (col & 7))) & 1) {
        for (int dy = 0; dy < scale; dy++)
          for (int dx = 0; dx < scale; dx++)
            lfbSet(x + col * scale + dx, y + row * scale + dy, color);
      }
    }
  }
}

// draw a UTF-8 string: ASCII uses the 3x5 font, CJK uses the 16x16 font
void drawCJKText(int x, int y, const char *s, uint16_t color, int scale) {
  while (*s) {
    uint8_t c = (uint8_t)*s;
    if (c < 0x80) {
      drawChar(x, y + (16 * scale - 5 * FONT_SCALE) / 2, (char)c, color);
      x += 4 * FONT_SCALE;
      s++;
      continue;
    }
    uint16_t cp = 0;
    if ((c & 0xE0) == 0xC0) {
      cp = ((uint16_t)(c & 0x1F) << 6) | ((uint8_t)*++s & 0x3F);
      s++;
    } else if ((c & 0xF0) == 0xE0) {
      cp = ((uint16_t)(c & 0x0F) << 12) | (((uint8_t)*++s & 0x3F) << 6);
      cp |= ((uint8_t)*++s & 0x3F);
      s++;
    } else {
      s++;
      continue;
    }
    drawCJKChar(x, y, cp, color, scale);
    x += 16 * scale;
  }
}

int cjkTextWidth(const char *s, int scale) {
  int w = 0;
  while (*s) {
    uint8_t c = (uint8_t)*s;
    if (c < 0x80) { w += 4 * FONT_SCALE; s++; }
    else if ((c & 0xE0) == 0xC0) { w += 16 * scale; s += 2; }
    else if ((c & 0xF0) == 0xE0) { w += 16 * scale; s += 3; }
    else s++;
  }
  return w;
}

void drawCJKTextCentered(int cx, int y, const char *s, uint16_t color, int scale) {
  drawCJKText(cx - cjkTextWidth(s, scale) / 2, y, s, color, scale);
}

void lfbFill(uint16_t c) {
  uint16_t *p = lfb;
  for (int i = 0; i < 240 * 135; i++) *p++ = c;
}

void lfbRect(int16_t x, int16_t y, int16_t w, int16_t h, uint16_t c) {
  int16_t x1 = x + w - 1, y1 = y + h - 1;
  if (x1 < 0 || y1 < 0 || x >= 240 || y >= 135) return;
  if (x < 0) x = 0;
  if (y < 0) y = 0;
  if (x1 >= 240) x1 = 239;
  if (y1 >= 135) y1 = 134;
  for (int row = y; row <= y1; row++) {
    uint16_t *p = &lfb[row * 240 + x];
    for (int col = x; col <= x1; col++) *p++ = c;
  }
}

// ---- drawing primitives for programmatic icons ----
void drawHLine(int x0, int x1, int y, uint16_t c) {
  if (x0 > x1) { int t = x0; x0 = x1; x1 = t; }
  for (int x = x0; x <= x1; x++) lfbSet(x, y, c);
}

void drawLine(int x0, int y0, int x1, int y1, uint16_t c) {
  int dx = abs(x1 - x0), sx = x0 < x1 ? 1 : -1;
  int dy = -abs(y1 - y0), sy = y0 < y1 ? 1 : -1;
  int err = dx + dy;
  for (;;) {
    lfbSet(x0, y0, c);
    if (x0 == x1 && y0 == y1) break;
    int e2 = 2 * err;
    if (e2 >= dy) { err += dy; x0 += sx; }
    if (e2 <= dx) { err += dx; y0 += sy; }
  }
}

void fillTriangle(int x0, int y0, int x1, int y1, int x2, int y2, uint16_t c) {
  // sort vertices by y
  if (y0 > y1) { int t; t=x0;x0=x1;x1=t; t=y0;y0=y1;y1=t; }
  if (y0 > y2) { int t; t=x0;x0=x2;x2=t; t=y0;y0=y2;y2=t; }
  if (y1 > y2) { int t; t=x1;x1=x2;x2=t; t=y1;y1=y2;y2=t; }
  float dx02 = (y2 > y0) ? (float)(x2 - x0) / (y2 - y0) : 0;
  float dx01 = (y1 > y0) ? (float)(x1 - x0) / (y1 - y0) : 0;
  float dx12 = (y2 > y1) ? (float)(x2 - x1) / (y2 - y1) : 0;
  float xa = (float)x0, xb = (float)x0;
  for (int y = y0; y <= y2; y++) {
    int xL = (int)xa, xR = (int)xb;
    if (xL > xR) { int t = xL; xL = xR; xR = t; }
    drawHLine(xL, xR, y, c);
    xa += dx02;
    xb += (y < y1) ? dx01 : dx12;
  }
}

void drawArc(int cx, int cy, int r, float a0deg, float a1deg, uint16_t c) {
  int steps = 20;
  float px = 0, py = 0;
  for (int i = 0; i <= steps; i++) {
    float a = (a0deg + (a1deg - a0deg) * i / steps) * 3.14159f / 180.0f;
    float nx = cx + r * cos(a), ny = cy + r * sin(a);
    if (i) drawLine((int)px, (int)py, (int)nx, (int)ny, c);
    px = nx; py = ny;
  }
}

// ---- programmatic menu icons (86x86 box at x,y) ----
void iconSettings(int x, int y) { // sliders
  int ys[3] = {y+20, y+43, y+66};
  int kn[3] = {x+32, x+54, x+40};
  for (int i = 0; i < 3; i++) {
    for (int t = 0; t < 3; t++) drawLine(x+14, ys[i]-1+t, x+72, ys[i]-1+t, COL_RING);
    drawDisc(kn[i], ys[i], 7, ACC_SETTINGS);
  }
}

void iconBattery(int x, int y) { // landscape battery, cap on the right
  lfbRect(x+70, y+38, 6, 10, COL_RING);            // terminal (right side)
  for (int t = 0; t < 3; t++) {                    // body outline
    drawLine(x+10+t, y+28, x+70, y+28, COL_RING);
    drawLine(x+10, y+28, x+10, y+58, COL_RING);
    drawLine(x+70, y+28, x+70, y+58, COL_RING);
    drawLine(x+10+t, y+58, x+70, y+58, COL_RING);
  }
  lfbRect(x+14, y+32, 34, 22, ACC_BATTERY);        // ~60% charge
}

void iconLight(int x, int y) { // lightbulb
  for (int i = 0; i < 6; i++) {
    float a = i * 3.14159f / 3.0f;
    int x0 = x+43 + (int)(22.0f * cos(a));
    int y0 = y+34 + (int)(22.0f * sin(a));
    int x1 = x+43 + (int)(30.0f * cos(a));
    int y1 = y+34 + (int)(30.0f * sin(a));
    drawLine(x0, y0, x1, y1, ACC_LIGHT);
  }
  drawDisc(x+43, y+34, 18, ACC_LIGHT);             // bulb
  drawDisc(x+37, y+28, 5, RGB565(255,240,180));    // highlight
  lfbRect(x+36, y+52, 14, 8, COL_RING);            // base
  lfbRect(x+41, y+60, 4, 6, COL_RING);
}

void iconPicture(int x, int y) { // framed landscape
  for (int t = 0; t < 3; t++) {
    drawLine(x+12+t, y+12, x+74, y+12, COL_RING);
    drawLine(x+12, y+12, x+12, y+74, COL_RING);
    drawLine(x+74, y+12, x+74, y+74, COL_RING);
    drawLine(x+12+t, y+74, x+74, y+74, COL_RING);
  }
  drawDisc(x+58, y+28, 6, ACC_LIGHT);              // sun
  fillTriangle(x+16, y+72, x+38, y+40, x+60, y+72, ACC_MOUNTAIN);
  fillTriangle(x+42, y+72, x+58, y+50, x+76, y+72, ACC_SETTINGS);
}

void iconMoon(int x, int y) { // crescent + stars
  drawDisc(x+46, y+40, 20, ACC_MOON);
  drawDisc(x+56, y+32, 18, COL_BG);                // cut out the crescent
  drawLine(x+26, y+18, x+26, y+26, ACC_MOON);      // stars (plus marks)
  drawLine(x+22, y+22, x+30, y+22, ACC_MOON);
  drawLine(x+66, y+56, x+66, y+64, ACC_MOON);
  drawLine(x+62, y+60, x+70, y+60, ACC_MOON);
  drawLine(x+18, y+52, x+18, y+58, ACC_MOON);
  drawLine(x+15, y+55, x+21, y+55, ACC_MOON);
}

void iconWireless(int x, int y) { // radio waves
  // WiFi style: dot at the bottom + three arcs fanning upward, centered
  int cx = x + 43, cy = y + 56;
  drawDisc(cx, cy, 6, ACC_SETTINGS);
  drawArc(cx, cy, 12, -145, -35, ACC_SETTINGS);
  drawArc(cx, cy, 20, -145, -35, ACC_SETTINGS);
  drawArc(cx, cy, 28, -145, -35, ACC_SETTINGS);
}

void drawMenuIcon(int x, int y, int p) {
  switch (p) {
    case 0: iconSettings(x, y); break;
    case 1: iconBattery(x, y); break;
    case 2: iconLight(x, y); break;
    case 3: iconPicture(x, y); break;
    case 4: iconMoon(x, y); break;
    case 5: iconWireless(x, y); break;
  }
}

void lfbThumbs(int active) {
  int x = (240 - (NUM_PAGES*(THUMB_SIZE+THUMB_GAP) - THUMB_GAP)) / 2;
  for (int i = 0; i < NUM_PAGES; i++) {
    lfbRect(x, THUMB_Y, THUMB_SIZE, THUMB_SIZE,
            (i == active) ? COL_THUMB_ON : COL_THUMB_OFF);
    x += THUMB_SIZE + THUMB_GAP;
  }
}

// ---- text (3x5 font, scaled FONT_SCALE x) ----
void drawChar(int x, int y, char c, uint16_t color) {
  const uint8_t *g = FONT3X5[fontIndex(c)];
  for (int row = 0; row < 5; row++) {
    uint8_t bits = g[row];
    for (int col = 0; col < 3; col++) {
      // glyphs are stored with bit 2 = leftmost column
      if (bits & (1 << (2 - col))) {
        for (int dy = 0; dy < FONT_SCALE; dy++)
          for (int dx = 0; dx < FONT_SCALE; dx++)
            lfbSet(x + col * FONT_SCALE + dx, y + row * FONT_SCALE + dy, color);
      }
    }
  }
}

void drawText(int x, int y, const char *s, uint16_t color) {
  while (*s) {
    drawChar(x, y, *s++, color);
    x += 4 * FONT_SCALE;
  }
}

void drawTextCentered(int cx, int cy, const char *s, uint16_t color) {
  int w = (int)strlen(s) * 4 * FONT_SCALE - FONT_SCALE;
  drawText(cx - w / 2, cy - FONT_SCALE * 5 / 2 + 1, s, color);
}

// ASCII text at an arbitrary pixel scale (for big numbers)
void drawTextBig(int x, int y, const char *s, uint16_t color, int scale) {
  while (*s) {
    const uint8_t *g = FONT3X5[fontIndex(*s)];
    for (int row = 0; row < 5; row++)
      for (int col = 0; col < 3; col++)
        if (g[row] & (1 << (2 - col)))
          for (int dy = 0; dy < scale; dy++)
            for (int dx = 0; dx < scale; dx++)
              lfbSet(x + col * scale + dx, y + row * scale + dy, color);
    x += 4 * scale;
    s++;
  }
}

// 18650 discharge curve: voltage mV -> percent
int battPercent(uint16_t mv) {
  if (mv < 2800 || mv > 4600) return -1; // no valid battery reading
  static const int pts[11][2] = {
    {4200,100},{4100,95},{4000,85},{3900,75},{3800,62},
    {3700,48},{3600,33},{3500,20},{3400,10},{3300,4},{3000,0}
  };
  if (mv >= pts[0][0]) return 100;
  if (mv <= pts[10][0]) return 0;
  for (int i = 0; i < 10; i++) {
    if (mv <= pts[i][0] && mv > pts[i + 1][0]) {
      return pts[i + 1][1] + (pts[i][1] - pts[i + 1][1]) *
             (mv - pts[i + 1][0]) / (pts[i][0] - pts[i + 1][0]);
    }
  }
  return 0;
}

// ---- shapes ----
void drawDisc(int cx, int cy, int r, uint16_t color) {
  for (int dy = -r; dy <= r; dy++)
    for (int dx = -r; dx <= r; dx++)
      if (dx*dx + dy*dy <= r*r) lfbSet(cx + dx, cy + dy, color);
}

void drawRing(int cx, int cy, int r, uint16_t color) {
  int inner = (r - 2) * (r - 2);
  for (int dy = -r; dy <= r; dy++)
    for (int dx = -r; dx <= r; dx++) {
      int d2 = dx*dx + dy*dy;
      if (d2 <= r*r && d2 >= inner) lfbSet(cx + dx, cy + dy, color);
    }
}

void drawBtn(int cx, int cy, int r, bool pressed, const char *label) {
  if (pressed) {
    drawDisc(cx, cy, r, COL_HI);
    drawTextCentered(cx, cy, label, COL_TEXT_ON);
  } else {
    drawRing(cx, cy, r, COL_RING);
    drawTextCentered(cx, cy, label, COL_RING);
  }
}

// layout transform: shrink the whole stick layout around the screen center
int lx(int x) { return 120 + (int)((x - 120) * layoutScale); }
int ly(int y) { return 70 + (int)((y - 70) * layoutScale); }
int lr(int r) { return (int)(r * layoutScale); }
void layoutBtn(int cx, int cy, int r, bool pressed, const char *label) {
  drawBtn(lx(cx), ly(cy), lr(r), pressed, label);
}

void layoutSquare(int x, int y, int size, bool pressed, const char *label) {
  int sx = lx(x), sy = ly(y), ss = lr(size);
  if (ss < 2) return;
  if (pressed) {
    lfbRect(sx, sy, ss, ss, COL_HI);
    drawTextCentered(sx + ss / 2, sy + ss / 2, label, COL_TEXT_ON);
  } else {
    for (int t = 0; t < 2; t++) {
      drawLine(sx + t, sy, sx + ss - 1, sy, COL_RING);
      drawLine(sx + t, sy + ss - 1, sx + ss - 1, sy + ss - 1, COL_RING);
      drawLine(sx, sy + t, sx, sy + ss - 1, COL_RING);
      drawLine(sx + ss - 1, sy + t, sx + ss - 1, sy + ss - 1, COL_RING);
    }
    drawTextCentered(sx + ss / 2, sy + ss / 2, label, COL_RING);
  }
}

// small battery indicator with fill proportional to pct
void drawMiniBattery(int x, int y, int w, int h, int pct, uint16_t color) {
  for (int t = 0; t < 2; t++) {
    drawLine(x + t, y, x + w, y, color);
    drawLine(x, y, x, y + h, color);
    drawLine(x + w, y, x + w, y + h, color);
    drawLine(x + t, y + h, x + w, y + h, color);
  }
  lfbRect(x + w, y + h / 3, 2, h / 3, color);      // terminal
  int fw = (w - 4) * pct / 100;
  if (fw > 0) lfbRect(x + 2, y + 2, fw, h - 4, ACC_BATTERY);
}

// small USB trident icon
void drawUsbIcon(int x, int y, uint16_t color) {
  drawLine(x + 3, y - 5, x + 3, y - 1, color);
  drawLine(x + 8, y - 5, x + 8, y - 1, color);
  drawLine(x + 13, y - 5, x + 13, y - 1, color);
  drawLine(x - 2, y - 1, x + 18, y - 1, color);    // crossbar
  drawLine(x + 8, y - 1, x + 8, y + 3, color);     // stem
  drawLine(x + 2, y + 3, x + 14, y + 3, color);    // base
  drawLine(x + 4, y + 6, x + 8, y + 8, color);
  drawLine(x + 8, y + 8, x + 12, y + 6, color);
  drawLine(x + 8, y + 3, x + 8, y + 8, color);
}

// tiny WiFi-style icon for the status bar (dot + arcs fanning upward)
void drawMiniWireless(int x, int y, bool linked) {
  uint16_t c = linked ? ACC_SETTINGS : RGB565(70,78,92);
  drawDisc(x, y, 2, c);
  drawArc(x, y, 4, -145, -35, c);
  drawArc(x, y, 7, -145, -35, c);
  drawArc(x, y, 10, -145, -35, c);
}

// ---- button layout view ----
const char *socdName(uint8_t m) {
  static const char *n[] = {"UP", "NEU", "2ND", "1ST", "BYP"};
  return (m < 5) ? n[m] : "?";
}

const char *dpadName(uint8_t m) {
  static const char *n[] = {"DIG", "LAN", "RAN"};
  return (m < 3) ? n[m] : "?";
}

const char *modeName(uint8_t m) {
  static const char *n[] = {"XIN","SW","PS3","KBD","PS4","XB1","MDM","NEO",
                            "PCE","EGR","AST","PSC","XBO","PS5","GEN","SWP","P5G"};
  return (m < 17) ? n[m] : "?";
}

void drawStatusBar() {
  char buf[40];
  snprintf(buf, sizeof(buf), "SOCD:%s DP:%s MODE:%s",
           socdName(stSocd), dpadName(stDpadMode), modeName(stInputMode));
  drawText(4, 3, buf, COL_TEXT);
  // power indicator: USB icon or battery icon + percent
  if (stBattFlags & 0x02) {
    drawUsbIcon(206, 7, ACC_SETTINGS);
  } else {
    int pct = battPercent(stBattMv);
    if (pct >= 0) {
      drawMiniBattery(198, 2, 18, 10, pct, COL_TEXT);
    }
  }
  if (radioUp) drawMiniWireless(232, 11, radioLinked);
}

// layout tables: movement side per layout + shared right cluster
static const LayoutBtn HITBOX_MOVE[] = {
  {0x04, 17, 44, 13, "L", 1, 0},
  {0x02, 54, 44, 13, "D", 1, 0},
  {0x08, 86, 66, 13, "R", 1, 0},
  {0x01, 97, 120, 13, "U", 1, 0},
};
static const LayoutBtn WASD_MOVE[] = {
  {0x01, 52, 44, 8, "U", 1, 1},
  {0x02, 52, 88, 8, "D", 1, 1},
  {0x04, 30, 66, 8, "L", 1, 1},
  {0x08, 74, 66, 8, "R", 1, 1},
};
static const LayoutBtn RIGHT_CLUSTER[] = {
  {0x0004, 110, 48, 13, "B3", 0, 0},
  {0x0008, 146, 36, 13, "B4", 0, 0},
  {0x0020, 182, 36, 13, "R1", 0, 0},
  {0x0010, 218, 48, 13, "L1", 0, 0},
  {0x0001, 110, 86, 13, "B1", 0, 0},
  {0x0002, 146, 74, 13, "B2", 0, 0},
  {0x0040, 182, 74, 13, "R2", 0, 0},
  {0x0080, 218, 86, 13, "L2", 0, 0},
};

void drawLayoutEntry(const LayoutBtn &e, uint16_t b, uint8_t d) {
  bool pressed = e.dpad ? (d & e.mask) : (b & e.mask);
  if (e.square) layoutSquare(e.x, e.y, e.r * 2, pressed, e.label);
  else layoutBtn(e.x, e.y, e.r, pressed, e.label);
}

void drawLever() {
  // big ring + a blue dot that follows the dpad direction
  int cx = lx(USER_LEVER_X), cy = ly(USER_LEVER_Y);
  drawRing(cx, cy, lr(USER_LEVER_RING), COL_RING);
  int dx = 0, dy = 0;
  uint8_t d = lastDpad;
  if (d & 0x01) dy -= lr(8); // UP
  if (d & 0x02) dy += lr(8); // DOWN
  if (d & 0x04) dx -= lr(8); // LEFT
  if (d & 0x08) dx += lr(8); // RIGHT
  drawDisc(cx + dx, cy + dy, lr(USER_LEVER_KNOB), ACC_SETTINGS);
}

void drawButtonLayout() {
  uint16_t b = lastButtons;
  uint8_t d = lastDpad;
  int layout = histOpts[1].value;
  if (layout == 0) {                    // 街机: lever
    drawLever();
  } else if (layout == 1) {             // HITBOX
    for (int i = 0; i < 4; i++) drawLayoutEntry(HITBOX_MOVE[i], b, d);
  } else if (layout == 2) {             // WASD
    for (int i = 0; i < 4; i++) drawLayoutEntry(WASD_MOVE[i], b, d);
  } else if (layout == 3) {             // 自定义: PC 向导生成的布局
#if defined(USER_LAYOUT)
    if (USER_SHOW_LEVER) {
      drawLever();                       // 摇杆捕获 D-Pad，开启时不再画移动键
    } else {
      for (int i = 0; i < (int)(sizeof(USER_MOVE) / sizeof(USER_MOVE[0])); i++)
        drawLayoutEntry(USER_MOVE[i], b, d);
    }
#else
    for (int i = 0; i < 4; i++) drawLayoutEntry(HITBOX_MOVE[i], b, d);
#endif
  } else {                              // fallback -> HITBOX
    for (int i = 0; i < 4; i++) drawLayoutEntry(HITBOX_MOVE[i], b, d);
  }
  // 右侧按键：预设用内置布局，自定义用 PC 向导生成的布局
#if defined(USER_LAYOUT)
  if (layout == 3) {
    for (int i = 0; i < (int)(sizeof(USER_CLUSTER) / sizeof(USER_CLUSTER[0])); i++)
      drawLayoutEntry(USER_CLUSTER[i], b, d);
  } else {
    for (int i = 0; i < 8; i++) drawLayoutEntry(RIGHT_CLUSTER[i], b, d);
  }
#else
  for (int i = 0; i < 8; i++) drawLayoutEntry(RIGHT_CLUSTER[i], b, d);
#endif
}

void pushHist(const char *label) {
  if (!histOpts[0].value) return; // input history disabled
  strncpy(histLabels[histHead], label, 2);
  histLabels[histHead][2] = 0;
  histHead = (histHead + 1) % HIST_MAX;
  if (histCount < HIST_MAX) histCount++;
  redrawNeeded = true;
}

void drawInputHistory() {
  if (!histOpts[0].value) return;
  int x = 6;
  for (int i = 0; i < histCount; i++) {
    int idx = (histHead - histCount + i + HIST_MAX) % HIST_MAX; // oldest first
    bool newest = (i == histCount - 1);
    drawTextBig(x, 124, histLabels[idx], newest ? COL_HI : RGB565(130,140,155), 1);
    x += (int)strlen(histLabels[idx]) * 4 + 6;
    if (x > 216) break;
  }
}

// ---- scene render ----
void drawPageContent(int x, int p) {
  drawCJKTextCentered(x + ICON_W / 2, TITLE_Y, PAGE_TITLES[p], COL_TEXT, 1);
  drawMenuIcon(x, ICON_Y, p);
}

void renderSub() {
  lfbFill(COL_BG);
  SubPageDef &def = subDefs[subPage];
  if (subPage == 1) { // 电池: custom status page
    drawCJKTextCentered(120, 6, "电池", COL_TEXT, 1);
    int pct = battPercent(stBattMv);
    char buf[16];
    bool usb = (stBattFlags & 0x02) != 0;
    if (usb || pct < 0) {
      snprintf(buf, sizeof(buf), "--");
    } else {
      snprintf(buf, sizeof(buf), "%d%%", pct);
    }
    drawTextBig(120 - ((int)strlen(buf) * 12 - 3) / 2, 34, buf, ACC_BATTERY, 3);
    snprintf(buf, sizeof(buf), "电压 %d.%02dV", stBattMv / 1000, (stBattMv % 1000) / 10);
    drawCJKTextCentered(120, 78, buf, COL_TEXT, 1);
    drawCJKTextCentered(120, 104, usb ? "USB连接" : "电池供电",
                        RGB565(120,132,150), 1);
    drawCJKTextCentered(120, 122, "B返回", RGB565(120,132,150), 1);
    return;
  }
  if (def.sectionCount == 0) { // placeholder until the page is built
    drawCJKTextCentered(120, 5, PAGE_TITLES[subPage], COL_TEXT, 1);
    drawMenuIcon((240 - ICON_W) / 2, 30, subPage);
    drawCJKTextCentered(120, 122, "待实现", RGB565(170,180,195), 1);
    return;
  }
  if (subList) { // section list level
    drawCJKTextCentered(120, 5, PAGE_TITLES[subPage], COL_TEXT, 1);
    int hY = 28 + (int)(selY - scrollOff);
    lfbRect(6, hY - 2, 228, 19, RGB565(42,54,72)); // gliding highlight bar
    int first = (int)(scrollOff / 30.0f);
    for (int i = first; i < def.sectionCount && i < first + 4; i++) {
      int y = 28 + (int)(i * 30 - scrollOff);
      if (y < 14 || y > 118) continue;
      if (i == subSection) {
        drawCJKText(14, y, def.sections[i].title, COL_HI, 1);
        drawCJKText(218, y, ">", ACC_SETTINGS, 1);
      } else {
        drawCJKText(14, y, def.sections[i].title, COL_TEXT, 1);
      }
    }
    drawScrollbar(def.sectionCount, scrollOff, 3, 30, 232, 28, 118);
    drawCJKTextCentered(120, 122, "A进入 B返回 上下选择", RGB565(120,132,150), 1);
  } else { // option list level
    MenuSection &sec = def.sections[subSection];
    drawCJKTextCentered(120, 5, sec.title, COL_TEXT, 1);
    if (subPage == 5) { // 无线: link status right-aligned on the title row
      char lb[24];
      if (radioUp && radioLinked) {
        snprintf(lb, sizeof(lb), "已连接 %d%%", radioHistOk);
      } else {
        snprintf(lb, sizeof(lb), "断链");
      }
      drawCJKText(226 - cjkTextWidth(lb, 1), 5, lb,
                  radioLinked ? ACC_SETTINGS : RGB565(170,70,70), 1);
    }
    int hY = 28 + (int)(selY - scrollOff);
    lfbRect(6, hY - 2, 228, 19, RGB565(42,54,72)); // gliding highlight bar
    int first = (int)(scrollOff / 24.0f);
    for (int i = first; i < sec.count && i < first + 5; i++) {
      MenuOpt *o = &sec.opts[i];
      int y = 28 + (int)(i * 24 - scrollOff);
      if (y < 14 || y > 118) continue;
      if (o->type == OPT_SLIDER) {
        uint16_t c = (i == subSel) ? ACC_SETTINGS : COL_RING;
        drawCJKText(14, y, o->label, (i == subSel) ? COL_HI : COL_TEXT, 1);
        drawSlider(86, y, 90, o->value, o->max, c);
        char buf[8];
        snprintf(buf, sizeof(buf), "%d", o->value);
        drawCJKText(182, y, buf, c, 1);
      } else {
        bool editable = (o->type != OPT_ACTION);
        if (i == subSel) {
          if (editable) drawCJKText(8, y, "<", ACC_SETTINGS, 1);
          drawCJKText(18, y, o->label, COL_HI, 1);
          drawOptValue(o, editable ? 214 : 226, y, ACC_SETTINGS);
          if (editable) drawCJKText(224, y, ">", ACC_SETTINGS, 1);
        } else {
          if (editable) drawCJKText(8, y, "<", RGB565(95,106,120), 1);
          drawCJKText(18, y, o->label, COL_TEXT, 1);
          drawOptValue(o, editable ? 214 : 226, y, COL_TEXT);
          if (editable) drawCJKText(224, y, ">", RGB565(95,106,120), 1);
        }
      }
    }
    drawScrollbar(sec.count, scrollOff, 4, 24, 232, 28, 118);
    drawCJKTextCentered(120, 122, sliderMode ? "左右调整 B退出" : "左右改值 上下选择 B返回",
                        RGB565(120,132,150), 1);
  }
  if (confirmOpen) {
    lfbRect(28, 40, 184, 58, RGB565(30,38,52));   // dialog box
    for (int t = 0; t < 2; t++) {
      drawLine(28+t, 40, 212-t, 40, COL_RING);
      drawLine(28, 40+t, 28, 98-t, COL_RING);
      drawLine(212, 40+t, 212, 98-t, COL_RING);
      drawLine(28+t, 98, 212-t, 98, COL_RING);
    }
    drawCJKTextCentered(120, 50, "是否立即保存", COL_TEXT, 1);
    int y = 74;
    if (confirmChoice == 0) {
      lfbRect(72, y - 2, 42, 19, RGB565(42,54,72));
      drawCJKText(80, y, "是", COL_HI, 1);
      drawCJKText(132, y, "否", COL_TEXT, 1);
    } else {
      drawCJKText(80, y, "是", COL_TEXT, 1);
      lfbRect(120, y - 2, 42, 19, RGB565(42,54,72));
      drawCJKText(128, y, "否", COL_HI, 1);
    }
    drawCJKTextCentered(120, 100, "左右选择 A确认", RGB565(120,132,150), 1);
  }
  if (millis() < savedFlashUntil) { // "已保存" toast
    lfbRect(78, 56, 84, 24, RGB565(30,38,52));
    drawCJKTextCentered(120, 60, configAcked ? "已确认" : "已保存", ACC_BATTERY, 1);
  }
}

void drawOptValue(const MenuOpt *o, int rightX, int y, uint16_t color) {
  char buf[24];
  const char *s;
  if (o->type == OPT_ACTION) {
    drawCJKText(rightX - 8, y, ">", color, 1);
    return;
  } else if (o->type == OPT_ENUM) {
    int i = o->value - o->min;
    s = (i >= 0 && i < o->nameCount) ? o->names[i] : "?";
    drawCJKText(rightX - cjkTextWidth(s, 1), y, s, color, 1);
  } else if (o->type == OPT_BOOL) {
    s = o->value ? "开启" : "关闭";
    drawCJKText(rightX - cjkTextWidth(s, 1), y, s, color, 1);
  } else {
    snprintf(buf, sizeof(buf), "%d%s", o->value, o->unit);
    drawCJKText(rightX - cjkTextWidth(buf, 1), y, buf, color, 1);
  }
}

void stepValue(MenuOpt *o, int dir) {
  int16_t v = o->value + dir * ((o->type == OPT_INT) ? o->step : 1);
  if (v < o->min) v = o->min;
  if (v > o->max) v = o->max;
  if (v != o->value) {
    o->value = v;
    subDirty = true;
    redrawNeeded = true;
  }
}

// keep the selected row visible, scrolling the list if needed
void clampScroll(int sel, int count, int visible, int &scroll) {
  if (count <= visible) { scroll = 0; return; }
  if (sel < scroll) scroll = sel;
  if (sel >= scroll + visible) scroll = sel - visible + 1;
  if (scroll > count - visible) scroll = count - visible;
}

// ease the selection highlight and list offset toward their targets
void startListAnim(int selIdx, int scrollIdx, int rowH) {
  selYFrom = selY;
  selYTo = (float)selIdx * rowH;
  scrollFrom = scrollOff;
  scrollTo = (float)scrollIdx * rowH;
  listAnimStart = millis();
  listAnimating = true;
}

void updateListAnim() {
  float t = (float)(millis() - listAnimStart) / LIST_ANIM_MS;
  if (t >= 1.0f) {
    selY = selYTo;
    scrollOff = scrollTo;
    listAnimating = false;
    redrawNeeded = true;
    return;
  }
  float e = 1.0f - (1.0f-t)*(1.0f-t)*(1.0f-t); // ease-out cubic
  selY = selYFrom + (selYTo - selYFrom) * e;
  scrollOff = scrollFrom + (scrollTo - scrollFrom) * e;
  redrawNeeded = true;
}

void drawScrollbar(int count, float off, int visible, int rowH, int x, int y0, int y1) {
  if (count <= visible) return;
  int trackH = y1 - y0;
  int thumbH = trackH * visible / count;
  if (thumbH < 8) thumbH = 8;
  float range = (float)((count - visible) * rowH);
  int thumbY = y0 + (range > 0 ? (int)(off / range * (trackH - thumbH)) : 0);
  lfbRect(x, y0, 3, trackH, RGB565(58,66,80));
  lfbRect(x, thumbY, 3, thumbH, ACC_SETTINGS);
}

// horizontal slider: value 0..max, thumb position proportional
void drawSlider(int x, int y, int w, int value, int max, uint16_t color) {
  int trackY = y + 7;
  lfbRect(x, trackY, w, 3, RGB565(58,66,80));          // track
  int thumbX = x + (w - 4) * value / max;
  if (thumbX > x) lfbRect(x, trackY, thumbX - x + 2, 3, color); // filled
  drawDisc(thumbX + 2, trackY + 1, 4, color);          // thumb
}

void snapshotOpts() {
  SubPageDef &def = subDefs[subPage];
  if (def.sectionCount == 0) return;
  MenuSection &sec = def.sections[subSection];
  for (int i = 0; i < sec.count && i < MAX_SUB_OPTS; i++) optSnap[i] = sec.opts[i].value;
}

void restoreOpts() {
  SubPageDef &def = subDefs[subPage];
  if (def.sectionCount == 0) return;
  MenuSection &sec = def.sections[subSection];
  for (int i = 0; i < sec.count && i < MAX_SUB_OPTS; i++) sec.opts[i].value = optSnap[i];
  if (subPage == 3) applyBgSettings(); // 背景: re-apply reverted values
  if (subPage == 0 && subSection == 1) applyHistSettings(); // 设置 > 显示
  if (subPage == 5) applyWirelessSettings(); // 无线
  redrawNeeded = true;
}

// go back one level (option list -> section list/menu)
void subBack() {
  SubPageDef &def = subDefs[subPage];
  if (subList || def.sectionCount <= 1) {
    view = VIEW_MENU;
    page = 0; // reset menu cursor to the first page
  } else {
    subList = true;
    subSection = 0; // reset section cursor to the first section
    secScroll = 0;
    selY = 0;
    scrollOff = 0;
    listAnimating = false;
  }
  redrawNeeded = true;
}

// ---- ESP32 本机设置持久化：LittleFS 配置文件（不依赖 NVS） ----
// 保存时把全部 ESP32 侧设置写成一个简单文本配置文件；
// 上电时先读取并应用，避免板上旧 NVS 数据导致的保存失败。

void applyBgSettings() {
  rotSwapRow = bgOpts[2].value ? 0 : 1;    // 水平翻转
  rotRevCol = bgOpts[3].value ? 0 : 1;     // 垂直翻转
  invertScreen = bgOpts[4].value != 0;     // 反色
  ledcWrite(BL, (uint32_t)bgOpts[1].value * 255 / 100); // 背光 PWM
  redrawNeeded = true;
}

void saveBgSettings() {
  saveConfigFile();
}

void saveHistSettings() {
  saveConfigFile();
}

// ---- input history toggle (settings > 显示) ----
void applyHistSettings() {
  layoutScale = histOpts[0].value ? 0.78f : 1.0f; // shrink layout for the strip
  redrawNeeded = true;
}

// ---- wireless settings (nRF24 on the ESP32) ----
void applyWirelessSettings() {
  radioUp = wlOpts[0].value != 0;
  static const int hb[] = {50, 20, 10};
  radioHeartbeatMs = hb[wlOpts[4].value];
  if (radioUp) {
    radio.powerUp();
    radio.setChannel((uint8_t)wlOpts[1].value);
    radio.setRfConfig(wlOpts[3].value == 0, (uint8_t)wlOpts[2].value);
  } else {
    radio.powerDown();
  }
  redrawNeeded = true;
}

void saveWirelessSettings() {
  saveConfigFile();
}

void saveConfigFile() {
  File f = LittleFS.open("/gpfusion.cfg", "w");
  if (!f) return;
  f.printf("hist=%d\n", histOpts[0].value);
  f.printf("layout=%d\n", histOpts[1].value);
  f.printf("bg_level=%d\n", bgOpts[0].value);
  f.printf("bl=%d\n", bgOpts[1].value);
  f.printf("hflip=%d\n", bgOpts[2].value);
  f.printf("vflip=%d\n", bgOpts[3].value);
  f.printf("inv=%d\n", bgOpts[4].value);
  f.printf("wl_on=%d\n", wlOpts[0].value);
  f.printf("wl_ch=%d\n", wlOpts[1].value);
  f.printf("wl_pwr=%d\n", wlOpts[2].value);
  f.printf("wl_rate=%d\n", wlOpts[3].value);
  f.printf("wl_hb=%d\n", wlOpts[4].value);
  f.flush();
  f.close();
}

void loadConfigFile() {
  if (!LittleFS.exists("/gpfusion.cfg")) return;
  File f = LittleFS.open("/gpfusion.cfg", "r");
  if (!f) return;
  while (f.available()) {
    String line = f.readStringUntil('\n');
    line.trim();
    int eq = line.indexOf('=');
    if (eq <= 0) continue;
    String k = line.substring(0, eq);
    int v = line.substring(eq + 1).toInt();
    if (k == "hist")      histOpts[0].value = constrain(v, 0, 1);
    else if (k == "layout") histOpts[1].value = constrain(v, 0, 3);
    else if (k == "bg_level") bgOpts[0].value = constrain(v, 0, 4);
    else if (k == "bl")   bgOpts[1].value = constrain(v, 0, 100);
    else if (k == "hflip") bgOpts[2].value = constrain(v, 0, 1);
    else if (k == "vflip") bgOpts[3].value = constrain(v, 0, 1);
    else if (k == "inv")  bgOpts[4].value = constrain(v, 0, 1);
    else if (k == "wl_on") wlOpts[0].value = constrain(v, 0, 1);
    else if (k == "wl_ch") wlOpts[1].value = constrain(v, 0, 125);
    else if (k == "wl_pwr") wlOpts[2].value = constrain(v, 0, 3);
    else if (k == "wl_rate") wlOpts[3].value = constrain(v, 0, 1);
    else if (k == "wl_hb") wlOpts[4].value = constrain(v, 0, 2);
  }
  f.close();
  applyBgSettings();
  applyHistSettings();
  applyWirelessSettings();
}

void renderScene(int16_t outX, int16_t inX) {
  if (view == VIEW_LAYOUT) {
    memcpy(lfb, BACKGROUND_IMG[bgOpts[0].value], 240 * 135 * 2);
    drawStatusBar();
    drawButtonLayout();
    drawInputHistory();
  } else if (view == VIEW_SUB) {
    renderSub();
  } else {
    lfbFill(COL_BG);
    drawPageContent(outX, page);
    drawPageContent(inX, (page + animDir + NUM_PAGES) % NUM_PAGES);
    lfbThumbs(page);
  }
}

void pushFrame() {
  uint8_t *out = rbuf;
  for (int my = 0; my < 240; my++) {
    for (int mx = 0; mx < 135; mx++) {
      int cx = rotSwapRow ? my : (239 - my);
      int cy = rotRevCol ? (134 - mx) : mx;
      uint16_t c = lfb[cy * 240 + cx];
      if (invertScreen) c = 0xFFFF - c;
      *out++ = (uint8_t)(c >> 8);
      *out++ = (uint8_t)(c & 0xFF);
    }
  }
  setWin(0, 0, 134, 239);
  digitalWrite(DC, HIGH);   // data mode for the bulk transfer
  digitalWrite(CS, LOW);
  SPI.transfer(rbuf, sizeof(rbuf));
  digitalWrite(CS, HIGH);
}

void drawPage() {
  renderScene(ICON_X, -ICON_W); // static page: incoming slot off-screen
  pushFrame();
}

void menuMove(int dir) {
  if (animating) { pendingDir = dir; return; }
  animDir = dir;
  animStart = millis();
  animating = true;
}

void updateAnimation() {
  unsigned long now = millis();
  if (now - lastFrameTime < FRAME_MS) return;
  lastFrameTime = now;
  float t = (float)(now - animStart) / ANIM_MS;
  if (t >= 1.0f) {
    animating = false;
    page = (page + animDir + NUM_PAGES) % NUM_PAGES;
    drawPage();
    if (pendingDir) {
      int d = pendingDir;
      pendingDir = 0;
      menuMove(d);
    }
    return;
  }
  // ease-out cubic
  float e = 1.0f - (1.0f-t)*(1.0f-t)*(1.0f-t);
  int off = (int)(240.0f * e);
  int16_t outX = ICON_X + animDir * (-off);
  int16_t inX  = ICON_X + animDir * (240 - off);

  renderScene(outX, inX);
  pushFrame();
}

// ---- CRC-16/CCITT-FALSE (poly 0x1021, init 0xFFFF) ----
static uint16_t crc16_update(uint16_t crc, uint8_t b) {
  crc ^= (uint16_t)b << 8;
  for (int i = 0; i < 8; i++) {
    crc = (crc & 0x8000) ? (uint16_t)((crc << 1) ^ 0x1021) : (uint16_t)(crc << 1);
  }
  return crc;
}

// RX state machine
uint8_t rxState = 0; // 0 idle, 1 ver, 2 type, 3 len, 4 payload, 5 crcLo, 6 crcHi
uint8_t rxType = 0;
uint8_t rxLen = 0;
uint8_t rxIdx = 0;
uint8_t rxPayload[24];
uint16_t rxCrcCalc = 0;
uint8_t rxCrcLo = 0;

void sendAck() {
  uint8_t frame[7];
  frame[0] = FRAME_MAGIC;
  frame[1] = FRAME_VERSION;
  frame[2] = FRAME_TYPE_ACK;
  frame[3] = 1;
  frame[4] = 0x01;
  uint16_t crc = 0xFFFF;
  for (int i = 1; i <= 4; i++) crc = crc16_update(crc, frame[i]);
  frame[5] = (uint8_t)(crc & 0xFF);
  frame[6] = (uint8_t)(crc >> 8);
  Serial.write(frame, sizeof(frame));
}

// push the 手柄 (gamepad) section values to the Pico
void sendGamepadConfig() {
  uint8_t frame[11];
  frame[0] = FRAME_MAGIC;
  frame[1] = FRAME_VERSION;
  frame[2] = FRAME_TYPE_CONFIG;
  frame[3] = 5;
  frame[4] = (uint8_t)gpOpts[0].value; // inputMode
  frame[5] = (uint8_t)gpOpts[1].value; // socdMode
  frame[6] = (uint8_t)gpOpts[2].value; // dpadMode
  frame[7] = (gpOpts[3].value ? 0x01 : 0) |
             (gpOpts[4].value ? 0x02 : 0) |
             (gpOpts[5].value ? 0x04 : 0); // fourWay / invertX / invertY
  frame[8] = (uint8_t)gpOpts[6].value;    // debounceDelay
  uint16_t crc = 0xFFFF;
  for (int i = 1; i <= 8; i++) crc = crc16_update(crc, frame[i]);
  frame[9] = (uint8_t)(crc & 0xFF);
  frame[10] = (uint8_t)(crc >> 8);
  Serial.write(frame, sizeof(frame));
  lastConfigSent = millis();
  configAcked = false;
}

// push the 灯光 (LED) section values to the Pico
void sendLedConfig() {
  uint8_t frame[16];
  frame[0] = FRAME_MAGIC;
  frame[1] = FRAME_VERSION;
  frame[2] = FRAME_TYPE_LED;
  frame[3] = 10;
  frame[4] = (uint8_t)ledOpts[0].value; // baseAnimationIndex
  frame[5] = (uint8_t)ledOpts[1].value; // brightness
  frame[6] = (uint8_t)ledOpts[2].value; // staticColorIndex
  frame[7] = ledOpts[6].value ? 0x01 : 0; // turnOffWhenSuspended
  uint16_t ch = (uint16_t)((100 - ledOpts[3].value) * 10 + 1);
  frame[8] = (uint8_t)(ch & 0xFF);
  frame[9] = (uint8_t)(ch >> 8);
  uint16_t rb = (uint16_t)((100 - ledOpts[4].value) * 10 + 1);
  frame[10] = (uint8_t)(rb & 0xFF);
  frame[11] = (uint8_t)(rb >> 8);
  uint16_t fl = (uint16_t)((100 - ledOpts[5].value) * 10 + 1);
  frame[12] = (uint8_t)(fl & 0xFF);
  frame[13] = (uint8_t)(fl >> 8);
  uint16_t crc = 0xFFFF;
  for (int i = 1; i <= 13; i++) crc = crc16_update(crc, frame[i]);
  frame[14] = (uint8_t)(crc & 0xFF);
  frame[15] = (uint8_t)(crc >> 8);
  Serial.write(frame, sizeof(frame));
  lastConfigSent = millis();
  configAcked = false;
}

void onInputFrame(uint8_t *payload, uint8_t len) {
  if (len >= 3) {
    uint16_t buttons = payload[0] | ((uint16_t)payload[1] << 8);
    uint8_t dpad = payload[2];
    uint16_t bEdge = buttons & ~lastButtons;
    uint8_t dEdge = dpad & ~lastDpad;
    bool inputChanged = (buttons != lastButtons || dpad != lastDpad);
    if (len >= 13) { // full state: sticks + triggers
      lastLX = payload[3] | ((uint16_t)payload[4] << 8);
      lastLY = payload[5] | ((uint16_t)payload[6] << 8);
      lastRX = payload[7] | ((uint16_t)payload[8] << 8);
      lastRY = payload[9] | ((uint16_t)payload[10] << 8);
      lastLT = payload[11];
      lastRT = payload[12];
    }

    // record input history edges
    if (dEdge & 0x01) pushHist("U");
    if (dEdge & 0x02) pushHist("D");
    if (dEdge & 0x04) pushHist("L");
    if (dEdge & 0x08) pushHist("R");
    if (bEdge & 0x0001) pushHist("1");
    if (bEdge & 0x0002) pushHist("2");
    if (bEdge & 0x0004) pushHist("3");
    if (bEdge & 0x0008) pushHist("4");
    if (bEdge & 0x0010) pushHist("L1");
    if (bEdge & 0x0020) pushHist("R1");
    if (bEdge & 0x0040) pushHist("L2");
    if (bEdge & 0x0080) pushHist("R2");
    if (bEdge & 0x0100) pushHist("S1");
    if (bEdge & 0x0200) pushHist("S2");
    if (bEdge & 0x0400) pushHist("L3");
    if (bEdge & 0x0800) pushHist("R3");
    if (bEdge & 0x1000) pushHist("A1");
    if (bEdge & 0x2000) pushHist("A2");

    if (view == VIEW_MENU) {
      if (dEdge & 0x04) menuMove(-1); // DPAD LEFT
      if (dEdge & 0x08) menuMove(+1); // DPAD RIGHT
      if (bEdge & 0x01) { // B1 / A = enter sub-page
        view = VIEW_SUB;
        subPage = page;
        subSel = 0;
        subSection = 0;
        subList = (subDefs[subPage].sectionCount > 1);
        subScroll = 0;
        secScroll = 0;
        selY = 0; scrollOff = 0;
        listAnimating = false;
        sliderMode = false;
        if (!subList) { // straight into the option list (single-section page)
          snapshotOpts();
          subDirty = false;
        }
        lastStepTime = millis();
        animating = false;
        pendingDir = 0;
        redrawNeeded = true;
      }
      if (bEdge & 0x02) { // B2 / B = cancel -> back to layout
        view = VIEW_LAYOUT;
        animating = false;
        pendingDir = 0;
        redrawNeeded = true;
      }
      s2PressStart = 0;
    } else if (view == VIEW_SUB) {
      SubPageDef &def = subDefs[subPage];
      unsigned long nowMs = millis();
      if (confirmOpen) { // save-confirm dialog
        if (dEdge & 0x0C) { // LEFT/RIGHT toggles 是/否
          confirmChoice = 1 - confirmChoice;
          redrawNeeded = true;
        }
        if (bEdge & 0x01) { // A confirms
          bool yes = (confirmChoice == 0);
          confirmOpen = false;
          if (yes) {
            if (subPage == 0 && subSection == 0) sendGamepadConfig(); // 设置 > 手柄
            else if (subPage == 2) sendLedConfig();                   // 灯光 > 彩灯
            else if (subPage == 3) saveBgSettings();                  // 背景 > NVS
            else if (subPage == 0 && subSection == 1) saveHistSettings(); // 设置 > 显示
            else if (subPage == 5) saveWirelessSettings();            // 无线 > NVS
            savedFlashUntil = millis() + 1200;
            snapshotOpts();
          } else {
            restoreOpts();
          }
          subDirty = false;
          subBack();
        }
        if (bEdge & 0x02) { // B = 否
          confirmOpen = false;
          restoreOpts();
          subDirty = false;
          subBack();
        }
      } else if (def.sectionCount > 0) {
        if (subList) { // section list: up/down select, A enter, B back to menu
          uint8_t heldD = dpad & 0x03;
          if (heldD && (dEdge & 0x03 || nowMs - lastStepTime >= 250)) {
            if (heldD & 0x01) subSection = (subSection + def.sectionCount - 1) % def.sectionCount;
            if (heldD & 0x02) subSection = (subSection + 1) % def.sectionCount;
            clampScroll(subSection, def.sectionCount, 3, secScroll);
            startListAnim(subSection, secScroll, 30);
            lastStepTime = nowMs;
            redrawNeeded = true;
          }
          if (!heldD) lastStepTime = 0;
          if (bEdge & 0x01) { // A = enter section
            subList = false;
            subSel = 0;
            subScroll = 0;
            selY = 0; scrollOff = 0;
            listAnimating = false;
            sliderMode = false;
            snapshotOpts();
            subDirty = false;
            lastStepTime = millis();
            redrawNeeded = true;
          }
          if (bEdge & 0x02) subBack(); // B = back to menu
        } else { // option list: up/down select, left/right change, A action, B back
          MenuSection &sec = def.sections[subSection];
          if (sliderMode) { // A entered a slider: left/right adjusts, B exits
            MenuOpt *so = &sec.opts[sliderIdx];
            uint8_t heldLR = dpad & 0x0C;
            if (heldLR && (dEdge & 0x0C || nowMs - lastStepTime >= 120)) {
              if (heldLR & 0x04) stepValue(so, -1);
              if (heldLR & 0x08) stepValue(so, +1);
              if (subPage == 3) applyBgSettings();
              else if (subPage == 0 && subSection == 1) applyHistSettings();
              else if (subPage == 5) applyWirelessSettings();
              lastStepTime = nowMs;
            }
            if (!heldLR) lastStepTime = 0;
            if (bEdge & 0x02) { // B exits slider mode
              sliderMode = false;
              redrawNeeded = true;
            }
          } else {
            uint8_t heldD = dpad & 0x03; // UP/DOWN
            if (heldD && (dEdge & 0x03 || nowMs - lastStepTime >= 250)) {
              if (heldD & 0x01) subSel = (subSel + sec.count - 1) % sec.count;
              if (heldD & 0x02) subSel = (subSel + 1) % sec.count;
              clampScroll(subSel, sec.count, 4, subScroll);
              startListAnim(subSel, subScroll, 24);
              lastStepTime = nowMs;
              redrawNeeded = true;
            }
            MenuOpt *o = &sec.opts[subSel];
            uint8_t heldLR = dpad & 0x0C; // LEFT/RIGHT (not for sliders)
            if (heldLR && o->type != OPT_SLIDER &&
                (dEdge & 0x0C || nowMs - lastStepTime >= 250)) {
              if (heldLR & 0x04) stepValue(o, -1);
              if (heldLR & 0x08) stepValue(o, +1);
              if (subPage == 3) applyBgSettings();
              else if (subPage == 0 && subSection == 1) applyHistSettings();
              else if (subPage == 5) applyWirelessSettings();
              lastStepTime = nowMs;
            }
            if (!heldD && !heldLR) lastStepTime = 0;
            if (bEdge & 0x01) { // A
              if (o->type == OPT_SLIDER) { // enter slider mode
                sliderMode = true;
                sliderIdx = subSel;
                lastStepTime = millis();
                redrawNeeded = true;
              } else if (o->type == OPT_ACTION) {
                if (subPage == 0 && subSection == 2 && subSel == 1) { // 系统 > 保存设置
                  sendGamepadConfig();
                  sendLedConfig();
                  saveBgSettings();
                  saveHistSettings();
                  saveWirelessSettings();
                  savedFlashUntil = millis() + 1200;
                  snapshotOpts();
                  subDirty = false;
                  redrawNeeded = true;
                }
                else if (subPage == 5 && subSel == 5) { // 无线 > 重新配对
                  radio.resetLink();
                  savedFlashUntil = millis() + 1200;
                }
              }
            }
            if (bEdge & 0x02) { // B = back one level, confirm save if dirty
              if (subDirty) {
                confirmOpen = true;
                confirmChoice = 0;
                redrawNeeded = true;
              } else {
                subBack();
              }
            }
          }
        }
      }
      if (def.sectionCount == 0 && (bEdge & 0x02)) { // placeholder page: B back
        view = VIEW_MENU;
        redrawNeeded = true;
      }
      s2PressStart = 0;
    } else { // VIEW_LAYOUT
      bool s2Held = (buttons & 0x0200) != 0;
      if (s2Held && !s2WasHeld) s2PressStart = millis();
      if (!s2Held) s2PressStart = 0;
      s2WasHeld = s2Held;
      if (s2PressStart && millis() - s2PressStart >= 3000) {
        s2PressStart = 0;
        view = VIEW_MENU;
        redrawNeeded = true;
      }
      if (inputChanged) redrawNeeded = true;
    }
    lastButtons = buttons;
    lastDpad = dpad;
  }
  lastActivity = millis();
  sendAck();
}

void onStatusFrame(uint8_t *payload, uint8_t len) {
  if (len >= 18) {
    stSocd = payload[0];
    stDpadMode = payload[1];
    stInputMode = payload[2];
    stFlags = payload[3];
    uint8_t anim = payload[5];
    uint8_t brightness = payload[6];
    uint8_t staticColor = payload[7];
    uint16_t chase = payload[8] | ((uint16_t)payload[9] << 8);
    uint16_t rainbow = payload[10] | ((uint16_t)payload[11] << 8);
    uint8_t ledFlags = payload[12];
    uint16_t flow = payload[13] | ((uint16_t)payload[14] << 8);
    stBattMv = payload[15] | ((uint16_t)payload[16] << 8);
    stBattFlags = payload[17];
    // sync the gamepad menu values with the Pico's real config,
    // but never overwrite staged (unsaved) edits in the sub-menu
    bool editing = (view == VIEW_SUB && (subDirty || confirmOpen));
    if (!editing && millis() - lastConfigSent > 2000) {
      gpOpts[0].value = payload[2]; // inputMode
      gpOpts[1].value = payload[0]; // socdMode
      gpOpts[2].value = payload[1]; // dpadMode
      gpOpts[3].value = (payload[3] & 0x01) ? 1 : 0;
      gpOpts[4].value = (payload[3] & 0x02) ? 1 : 0;
      gpOpts[5].value = (payload[3] & 0x04) ? 1 : 0;
      gpOpts[6].value = payload[4]; // debounceDelay
      ledOpts[0].value = anim > 5 ? 5 : anim;
      ledOpts[1].value = brightness > 5 ? 5 : brightness;
      ledOpts[2].value = staticColor > 15 ? 15 : staticColor;
      int cv = 100 - ((int)chase - 1) / 10;
      ledOpts[3].value = cv < 0 ? 0 : (cv > 100 ? 100 : cv);
      int rv = 100 - ((int)rainbow - 1) / 10;
      ledOpts[4].value = rv < 0 ? 0 : (rv > 100 ? 100 : rv);
      int fv = 100 - ((int)flow - 1) / 10;
      ledOpts[5].value = fv < 0 ? 0 : (fv > 100 ? 100 : fv);
      ledOpts[6].value = (ledFlags & 0x01) ? 1 : 0;
    }
    redrawNeeded = true;
  }
}

void handleRxByte(uint8_t b) {
  switch (rxState) {
    case 0:
      if (b == FRAME_MAGIC) rxState = 1;
      break;
    case 1:
      rxCrcCalc = 0xFFFF;
      rxCrcCalc = crc16_update(rxCrcCalc, b);
      rxState = (b == FRAME_VERSION) ? 2 : 0;
      break;
    case 2:
      rxType = b;
      rxCrcCalc = crc16_update(rxCrcCalc, b);
      rxState = 3;
      break;
    case 3:
      rxLen = b;
      rxCrcCalc = crc16_update(rxCrcCalc, b);
      if (rxLen > sizeof(rxPayload)) { rxState = 0; break; }
      rxIdx = 0;
      rxState = (rxLen == 0) ? 5 : 4;
      break;
    case 4:
      rxPayload[rxIdx++] = b;
      rxCrcCalc = crc16_update(rxCrcCalc, b);
      if (rxIdx == rxLen) rxState = 5;
      break;
    case 5:
      rxCrcLo = b;
      rxState = 6;
      break;
    case 6:
      if (b == (uint8_t)(rxCrcCalc >> 8) &&
          rxCrcLo == (uint8_t)(rxCrcCalc & 0xFF)) {
        if (rxType == FRAME_TYPE_INPUT) onInputFrame(rxPayload, rxLen);
        else if (rxType == FRAME_TYPE_STATUS) onStatusFrame(rxPayload, rxLen);
        else if (rxType == FRAME_TYPE_CONFIG_ACK) {
          configAcked = true;
          savedFlashUntil = millis() + 1200;
        }
      }
      rxState = 0;
      break;
  }
}

void setup(){
  ledcAttach(BL, 5000, 8);
  ledcWrite(BL, 255);
  pinMode(CS,OUTPUT);pinMode(DC,OUTPUT);pinMode(RST,OUTPUT);digitalWrite(CS,HIGH);
  SPI.begin(12,-1,11,-1);SPI.setFrequency(40000000);
  digitalWrite(RST,LOW);delay(10);digitalWrite(RST,HIGH);delay(120);
  cmd(0x01);delay(150);cmd(0x11);delay(150);
  cmd(0x3A);dat(0x55);cmd(0x36);dat(0x00);cmd(0x21);cmd(0x13);delay(10);cmd(0x29);delay(10);
  drawPage();
  Serial.begin(UART_BAUD, SERIAL_8N1, ESP_RX, ESP_TX);
  pinMode(48,OUTPUT);
  digitalWrite(48, LOW);
  nrfSpi.begin(16, 18, 17, -1); // SCK, MISO, MOSI (CSN/CE managed by driver)
  radio.begin(nrfSpi, NRF_CSN, NRF_CE);
  radioUp = true;
  LittleFS.begin(true);   // 挂载文件系统（首次自动格式化）
  loadConfigFile();
}

void loop(){
  while (Serial.available()) {
    handleRxByte((uint8_t)Serial.read());
  }
  if (animating) updateAnimation();
  if (listAnimating) updateListAnim();
  if (savedFlashUntil && millis() >= savedFlashUntil) { // toast expired
    savedFlashUntil = 0;
    redrawNeeded = true;
  }
  // wireless: forward full gamepad state + mode over nRF24
  if (radioUp) {
    uint8_t pkt[15];
    pkt[0] = stInputMode;             // mode the receiver should adopt
    pkt[1] = radioSeq++;
    pkt[2] = lastButtons & 0xFF;
    pkt[3] = lastButtons >> 8;
    pkt[4] = lastDpad;
    pkt[5] = lastLX & 0xFF;  pkt[6] = lastLX >> 8;
    pkt[7] = lastLY & 0xFF;  pkt[8] = lastLY >> 8;
    pkt[9] = lastRX & 0xFF;  pkt[10] = lastRX >> 8;
    pkt[11] = lastRY & 0xFF; pkt[12] = lastRY >> 8;
    pkt[13] = lastLT;
    pkt[14] = lastRT;
    unsigned long now = millis();
    bool changed = memcmp(&pkt[2], radioPrevState, 13) != 0;
    if (changed || now - lastRadioSend >= (unsigned long)radioHeartbeatMs) {
      memcpy(radioPrevState, &pkt[2], 13);
      bool acked = radio.writePacket(pkt);
      if (radioHist[radioHistIdx]) radioHistOk--;
      radioHist[radioHistIdx] = acked ? 1 : 0;
      if (acked) radioHistOk++;
      radioHistIdx = (radioHistIdx + 1) % 100;
      radioLinked = (radioHistOk >= 40); // majority of the last 100 ACKed
      lastRadioSend = now;
    }
  }
  // refresh status bar / wireless page periodically (no input events needed)
  static unsigned long lastUiRefresh = 0;
  if (millis() - lastUiRefresh >= 1000) {
    lastUiRefresh = millis();
    redrawNeeded = true;
  }
  if (redrawNeeded && !animating) {
    redrawNeeded = false;
    renderScene(ICON_X, -ICON_W);
    pushFrame();
  }
  digitalWrite(48, (millis() - lastActivity < 250) ? HIGH : LOW);
}
